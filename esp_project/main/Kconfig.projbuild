## esp_project/main/Kconfig.projbuild
```kconfig
menu "wifi my Configuration"

    config ESP_WIFI_SSID
        string "WiFi SSID"
        default "JelenaNet"
        help
            SSID (network name) for the example to connect to.

    config ESP_WIFI_PASSWORD
        string "WiFi Password"
        default "password"
        help
            WiFi password (WPA or WPA2) for the example to use.

    config ESP_MAXIMUM_RETRY
        int "Maximum retry"
        default 5
        help
            Set the Maximum retry to avoid station reconnecting to the AP unlimited when the AP is really inexistent.

    choice ESP_WIFI_SCAN_AUTH_MODE_THRESHOLD
        prompt "WiFi Scan auth mode threshold"
        default ESP_WIFI_AUTH_OPEN
        help
            The weakest authmode to accept in the scan mode.

        config ESP_WIFI_AUTH_OPEN
            bool "OPEN"
        config ESP_WIFI_AUTH_WEP
            bool "WEP"
        config ESP_WIFI_AUTH_WPA_PSK
            bool "WPA PSK"
        config ESP_WIFI_AUTH_WPA2_PSK
            bool "WPA2 PSK"
        config ESP_WIFI_AUTH_WPA_WPA2_PSK
            bool "WPA/WPA2 PSK"
        config ESP_WIFI_AUTH_WPA3_PSK
            bool "WPA3 PSK"
        config ESP_WIFI_AUTH_WPA2_WPA3_PSK
            bool "WPA2/WPA3 PSK"
        config ESP_WIFI_AUTH_WAPI_PSK
            bool "WAPI PSK"
    endchoice

endmenu

menu "Socket Configuration"

    choice WEBSOCKET_URI_SOURCE
        prompt "Websocket URI source"
        default WEBSOCKET_URI_FROM_STRING
        help
            Selects the source of the URI used in the example.

        config WEBSOCKET_URI_FROM_STRING
            bool "From string"

        config WEBSOCKET_URI_FROM_STDIN
            bool "From stdin"
    endchoice

    config WEBSOCKET_URI
        string "Websocket endpoint URI"
        depends on WEBSOCKET_URI_FROM_STRING
        default "ws://192.168.1.7:5000"
        help
            URL of websocket endpoint this example connects to and sends echo

endmenu


menu "Example Configuration"

    config SNTP_TIME_SERVER
        string "SNTP server name"
        default "pool.ntp.org"
        help
            Hostname of the main SNTP server.

    choice SNTP_TIME_SYNC_METHOD
        prompt "Time synchronization method"
        default SNTP_TIME_SYNC_METHOD_IMMED
        help
            Time synchronization method.

        config SNTP_TIME_SYNC_METHOD_IMMED
            bool "update time immediately when received"
        config SNTP_TIME_SYNC_METHOD_SMOOTH
            bool "update time with smooth method (adjtime)"
        config SNTP_TIME_SYNC_METHOD_CUSTOM
            bool "custom implementation"
    endchoice

endmenu

menu "BMX280 Options"
    choice BMX280_EXPECT_DEVICE
        prompt "Installed Sensor Model"
        help
            Set to the model of the sensor you are using (if you know it).
        default BMX280_EXPECT_BMP280
        config BMX280_EXPECT_DETECT
            bool "Auto"
        config BMX280_EXPECT_BME280
            bool "BME280"
        config BMX280_EXPECT_BMP280
            bool "BMP280"
    endchoice

    choice BMX280_ADDRESS
        prompt "I2C Slave Address"
        help
            Set the slave address of the sensor if you know it. The driver can
            automatically detect it if you don't know.
        default BMX280_ADDRESS_DETECT
        config BMX280_ADDRESS_DETECT
            bool "Auto"
        config BMX280_ADDERSS_LO
            bool "0x76 (SDO LOW)"
        config BMX280_ADDERSS_HI
            bool "0x77 (SDO HIGH)"
    endchoice

    config BMX280_TIMEOUT
        int "Read/Write Timeout"
        default 5
        help
            Number of ticks to wait for I2C read/write operations.

    menu "Default Configuration"
        choice BMX280_DEFAULT_TEMPERATURE_OVERSAMPLING
            prompt "Temperature Oversampling"
            default BMX280_DEFAULT_TEMPERATURE_OVERSAMPLING_X2
            help
                Refer to BMP280/BME280 Datasheet for more information.
            config BMX280_DEFAULT_TEMPERATURE_OVERSAMPLING_NONE
                bool "None"
            config BMX280_DEFAULT_TEMPERATURE_OVERSAMPLING_X1
                bool "x1"
            config BMX280_DEFAULT_TEMPERATURE_OVERSAMPLING_X2
                bool "x2"
            config BMX280_DEFAULT_TEMPERATURE_OVERSAMPLING_X4
                bool "x4"
            config BMX280_DEFAULT_TEMPERATURE_OVERSAMPLING_X8
                bool "x8"
            config BMX280_DEFAULT_TEMPERATURE_OVERSAMPLING_X16
                bool "x16"
        endchoice

        choice BMX280_DEFAULT_PRESSURE_OVERSAMPLING
            prompt "Pressure Oversampling"
            default BMX280_DEFAULT_PRESSURE_OVERSAMPLING_X16
            help
                Refer to BMP280/BME280 Datasheet for more information.
            config BMX280_DEFAULT_PRESSURE_OVERSAMPLING_NONE
                bool "None"
            config BMX280_DEFAULT_PRESSURE_OVERSAMPLING_X1
                bool "x1"
            config BMX280_DEFAULT_PRESSURE_OVERSAMPLING_X2
                bool "x2"
            config BMX280_DEFAULT_PRESSURE_OVERSAMPLING_X4
                bool "x4"
            config BMX280_DEFAULT_PRESSURE_OVERSAMPLING_X8
                bool "x8"
            config BMX280_DEFAULT_PRESSURE_OVERSAMPLING_X16
                bool "x16"
        endchoice

        choice BMX280_DEFAULT_STANDBY
            prompt "Cyclic Measurement Standby Time"
            default BMX280_DEFAULT_STANDBY_125M
            help
                Refer to BMP280/BME280 Datasheet for more information.
            config BMX280_DEFAULT_STANDBY_0M5
                bool "0.5ms"
            config BMX280_DEFAULT_STANDBY_62M5
                bool "62.5ms"
            config BMX280_DEFAULT_STANDBY_125M
                bool "125ms"
            config BMX280_DEFAULT_STANDBY_250M
                bool "250ms"
            config BMX280_DEFAULT_STANDBY_500M
                bool "500ms"
            config BMX280_DEFAULT_STANDBY_1000M
                bool "1000ms"
            config BMX280_DEFAULT_STANDBY_10M
                bool "BMP280: 2000ms // BME280: 10ms"
            config BMX280_DEFAULT_STANDBY_20M
                bool "BMP280: 4000ms // BME280: 20ms"
        endchoice

        choice BMX280_DEFAULT_IIR
            prompt "IIR Filter Sensitivity"
            default BMX280_DEFAULT_IIR_X16
            help
                Refer to BMP280/BME280 Datasheet for more information.
            config BMX280_DEFAULT_IIR_NONE
                bool "Filter Off"
            config BMX280_DEFAULT_IIR_X2
                bool "x2"
            config BMX280_DEFAULT_IIR_X4
                bool "x4"
            config BMX280_DEFAULT_IIR_X8
                bool "x8"
            config BMX280_DEFAULT_IIR_X16
                bool "x16"
        endchoice

        menu "BME280 Specific Options"
            depends on !(BMX280_EXPECT_BMP280)

            choice BMX280_DEFAULT_HUMIDITY_OVERSAMPLING
                prompt "Humidity Oversampling"
                default BMX280_DEFAULT_HUMIDITY_OVERSAMPLING_X1
                help
                    Refer to BME280 Datasheet for more information.
                config BMX280_DEFAULT_HUMIDITY_OVERSAMPLING_NONE
                    bool "None"
                config BMX280_DEFAULT_HUMIDITY_OVERSAMPLING_X1
                    bool "x1"
                config BMX280_DEFAULT_HUMIDITY_OVERSAMPLING_X2
                    bool "x2"
                config BMX280_DEFAULT_HUMIDITY_OVERSAMPLING_X4
                    bool "x4"
                config BMX280_DEFAULT_HUMIDITY_OVERSAMPLING_X8
                    bool "x8"
                config BMX280_DEFAULT_HUMIDITY_OVERSAMPLING_X16
                    bool "x16"
            endchoice
        endmenu
    endmenu
endmenu
```
